## app/boards/arm/go60/Kconfig.defconfig
```kconfig
# Copyright (c) 2021 The ZMK Contributors
# SPDX-License-Identifier: MIT

if BOARD_GO60_LH

config BOARD
    default "go60 lh"

config ZMK_SPLIT_ROLE_CENTRAL
    default y

endif # BOARD_GO60_LH

if BOARD_GO60_RH

config BOARD
    default "go60 rh"

endif # BOARD_GO60_RH

if BOARD_GO60_LH || BOARD_GO60_RH

config UART_0_INTERRUPT_DRIVEN
    depends on !ZMK_SPLIT_WIRED_UART_MODE_ASYNC

config ZMK_SPLIT
    default y

config ZMK_POINTING
    default y

config ZMK_POINTING_SMOOTH_SCROLLING
    default n

config ZMK_IDLE_TIMEOUT
    default 120000

config BT_CTLR
    default BT

config ZMK_KSCAN_MATRIX_WAIT_BETWEEN_OUTPUTS
    default 5

config PINCTRL
    default y

if USB

config USB_NRFX
    default y

config USB_DEVICE_STACK
    default y

endif # USB

if ZMK_BACKLIGHT

config PWM
    default y

config LED_PWM
    default y

endif # ZMK_BACKLIGHT

if ZMK_RGB_UNDERGLOW

config SPI
    default y

config WS2812_STRIP
    default y

endif # ZMK_RGB_UNDERGLOW

endif # BOARD_GO60_LH || BOARD_GO60_RH
```

## app/boards/arm/go60/go60_lh_defconfig
```kconfig
# Copyright (c) 2021 The ZMK Contributors
# SPDX-License-Identifier: MIT

CONFIG_SOC_SERIES_NRF52X=y
CONFIG_SOC_NRF52840_QIAA=y
CONFIG_BOARD_GO60_LH=y

# Enable both USB and BLE
CONFIG_ZMK_USB=y
CONFIG_ZMK_BLE=y

# Keyboard IDs
CONFIG_ZMK_KEYBOARD_NAME="Go60 Left"
CONFIG_USB_DEVICE_PID=0x27db
CONFIG_USB_DEVICE_VID=0x16c0
CONFIG_USB_DEVICE_MANUFACTURER="MoErgo"
CONFIG_USB_DEVICE_SN="moergo.com:GO60-0123456789ABCDEF"

CONFIG_BT_DEVICE_NAME="Go60"

CONFIG_BT_DIS_PNP_PID=0x27db
CONFIG_BT_DIS_PNP_VID=0x16c0
CONFIG_BT_DIS_MANUF="MoErgo"
CONFIG_BT_DIS_MODEL="Go60"

CONFIG_BT_CTLR_TX_PWR_PLUS_8=y

# Work-around for Windows bug with battery notifications
CONFIG_BT_GATT_ENFORCE_SUBSCRIPTION=n

# Allow unauthenticated re-pairing for already paired hosts. This would permit
# an attacker that can spoof the host's peer address to "steal" the keyboard
# pairing by overwriting it, but without access to the previous keys it can't
# establish a MITM, and the sudden loss of the keyboard would be very obvious to
# the previously-connected host.
CONFIG_BT_SMP_ALLOW_UNAUTH_OVERWRITE=y
CONFIG_ZMK_BLE_PASSKEY_ENTRY=n

# Fetch peripheral battery level for status display reporting
CONFIG_ZMK_SPLIT_BLE_CENTRAL_BATTERY_LEVEL_FETCHING=y

# Enable MPU
CONFIG_ARM_MPU=y

# Enable GPIO
CONFIG_GPIO=y

# Build configurations
CONFIG_BUILD_OUTPUT_UF2=y
CONFIG_BUILD_OUTPUT_UF2_FAMILY_ID="0x9809B007"
CONFIG_USE_DT_CODE_PARTITION=y

# Flash configuration
CONFIG_MPU_ALLOW_FLASH_WRITE=y
CONFIG_NVS=y
CONFIG_SETTINGS_NVS=y
CONFIG_FLASH=y
CONFIG_FLASH_PAGE_LAYOUT=y
CONFIG_FLASH_MAP=y

# Enable 32kHz crystal
CONFIG_CLOCK_CONTROL_NRF_K32SRC_XTAL=y

# Enable RGB underglow
CONFIG_ZMK_RGB_UNDERGLOW=y

# disable EXT_POWER until underglow gets turned on
CONFIG_ZMK_EXT_POWER_START=n

CONFIG_ZMK_RGB_UNDERGLOW_EXT_POWER=y
CONFIG_ZMK_RGB_UNDERGLOW_ON_START=n
CONFIG_ZMK_RGB_UNDERGLOW_BRT_STEP=2
CONFIG_ZMK_RGB_UNDERGLOW_BRT_MIN=2

# DO NOT CHANGE CONFIG_ZMK_RGB_UNDERGLOW_BRT_MAX TO ABOVE 40. Configuring
# BRT_MAX above 40% can draw more than 500mA current, which can potentially
# damage some computers. WARRANTY IS VOID IF BRT_MAX SET ABOVE 40.
CONFIG_ZMK_RGB_UNDERGLOW_BRT_MAX=40

CONFIG_ZMK_RGB_UNDERGLOW_EFF_START=3
CONFIG_ZMK_RGB_UNDERGLOW_HUE_START=285
CONFIG_ZMK_RGB_UNDERGLOW_SAT_START=75
CONFIG_ZMK_RGB_UNDERGLOW_BRT_START=16

# The power LED is implemented as a backlight
# For now, the power LED is acting as a "USB connected" indicator
CONFIG_ZMK_BACKLIGHT=y
CONFIG_ZMK_BACKLIGHT_ON_START=y
CONFIG_ZMK_BACKLIGHT_BRT_START=5
CONFIG_ZMK_BACKLIGHT_AUTO_OFF_IDLE=y
CONFIG_ZMK_BACKLIGHT_AUTO_OFF_USB=y

# The full two-byte consumer report space has compatibility issues with some
# operating systems, most notably macOS. Use the more basic single-byte usage
# space.
CONFIG_ZMK_HID_CONSUMER_REPORT_USAGES_BASIC=y

# Enable USB boot protocol support
CONFIG_ZMK_USB_BOOT=y
CONFIG_ZMK_HID_INDICATORS=y

# Turn on debugging to disable optimization. Debug messages can result in larger
# stacks, so enable stack protection and particularly a larger BLE peripheral stack.
# CONFIG_DEBUG=y
# CONFIG_DEBUG_THREAD_INFO=y
# CONFIG_EXCEPTION_STACK_TRACE=y
# CONFIG_HW_STACK_PROTECTION=y
# CONFIG_ZMK_SPLIT_BLE_PERIPHERAL_STACK_SIZE=1300

# Log via USB or Segger RTT
CONFIG_ZMK_USB_LOGGING=n
CONFIG_ZMK_RTT_LOGGING=n
```

## app/boards/arm/nrfmacro/Kconfig.board
```kconfig
# nrfmacro board configuration

# Copyright (c) 2020 The ZMK Contributors
# SPDX-License-Identifier: MIT

config BOARD_NRFMACRO
	bool "nrfmacro"
	depends on SOC_NRF52840_QIAA
```

## app/boards/arm/nrfmacro/Kconfig.defconfig
```kconfig
# Electronut Labs Papyr board configuration

# Copyright (c) 2020 The ZMK Contributors
# SPDX-License-Identifier: MIT

if BOARD_NRFMACRO

config BOARD
	default "nrfmacro"

# DISPLAY options: oled, epd, lcd, default: no display
choice
  prompt "nrfmacro Display option"
  depends on ZMK_DISPLAY
  help
    Specify the type of the display peripheral.

# config NRFMACRO_NO_DISPLAY
#   bool "No display screen"

config NRFMACRO_EPD_DISPLAY
  bool "Use epaper display"
  select SPI
  select IL0323
	select LVGL_USE_CONT
	select LVGL_FONT_MONTSERRAT_26
	select LVGL_FONT_MONTSERRAT_20
	select LVGL_FONT_MONTSERRAT_16
	select LVGL_USE_LABEL
	select LVGL_USE_IMG

config NRFMACRO_OLED_DISPLAY
  bool "Ues OLED display"
  select I2C
  select SSD1306
  select SSD1306_REVERSE_MODE

config NRFMACRO_LCD_DISPLAY
  bool "Use SHARP memory LCD"
  select SPI
  select LS0XX
	select LVGL_USE_CONT
	select LVGL_FONT_MONTSERRAT_26
	# select LVGL_FONT_MONTSERRAT_20
	# select LVGL_FONT_MONTSERRAT_16
	# select LVGL_USE_LABEL
	# select LVGL_USE_IMG

endchoice

# Role of the keyboard in split setup, default is master (i.e., central)
## NOTE: this is a dedicated config option for nrfmacro board, so that all shields
## using this board can share the some configuration. It's mainly used for controlling
## which widget to show on different side of the keyboard
choice
  prompt "Role of the keyboard"
  help
    Specify the role of the keyboard

config NRFMACRO_SHIELD_MASTER
  bool "master side, in charge of communication with host"

config NRFMACRO_SHIELD_SLAVE
  bool "slave side, acting as a peripheral to master side"

endchoice

# Rotate the display screen 180 degree (upside down)
config NRFMACRO_ROTATE_SCREEN
  bool "rotate the display screen upside down"

# Show product mark on the screen
config NRFMACRO_SCREEN_MARK_LOGO
  bool "show the mark logo on the screen"

choice
  prompt "Keyboard logo on the display screen"
  help
    Specify which logo to show on the centre of screen

config NRFMACRO_SCREEN_STANDARD_LOGO
  bool "Use the standard logo distributed with the firmware source"

config NRFMACRO_SCREEN_CUSTOM_LOGO
  bool "Use the customized logo designed by yourself"

endchoice

# Customizing margin of the display screen
config NRFMACRO_SCREEN_TOP_MARGIN
  int "top margin of display screen in pixel"
  depends on ZMK_DISPLAY
  default 2

config NRFMACRO_SCREEN_BOTTOM_MARGIN
  int "bottom margin of display screen in pixel"
  depends on ZMK_DISPLAY
  default 2

config NRFMACRO_SCREEN_LEFT_MARGIN
  int "left margin of display screen in pixel"
  depends on ZMK_DISPLAY
  default 2

config NRFMACRO_SCREEN_RIGHT_MARGIN
  int "right margin of display screen in pixel"
  depends on ZMK_DISPLAY
  default 2

# USB STACK setup
if USB_DEVICE_STACK

config USB_NRFX
	default y

endif # USB_DEVICE_STACK

config BT_CTLR
	default BT

config ZMK_BLE
	default y

config ZMK_USB
	default y

# DISPLAY setup
## common configuration
if ZMK_DISPLAY
config ZMK_DISPLAY_DEDICATED_THREAD_STACK_SIZE
  default 2048

endif # ZMK_DISPLAY

if ZMK_DISPLAY_STATUS_SCREEN_CUSTOM

if NRFMACRO_SHIELD_SLAVE
config LVGL_FONT_MONTSERRAT_16
    default y

choice LVGL_THEME_DEFAULT_FONT_NORMAL
    default LVGL_THEME_DEFAULT_FONT_NORMAL_MONTSERRAT_16

endchoice

config LVGL_FONT_MONTSERRAT_12
    default y
    
choice LVGL_THEME_DEFAULT_FONT_SMALL
    default LVGL_THEME_DEFAULT_FONT_SMALL_MONTSERRAT_12

endchoice
endif

endif # ZMK_DISPLAY_STATUS_SCREEN_CUSTOM

## dedicated configuration
if LVGL

config LVGL_BITS_PER_PIXEL
	default 1

choice LVGL_COLOR_DEPTH
	default LVGL_COLOR_DEPTH_1
endchoice

config LVGL_USE_CONT
  default y

## oled display configuration
if NRFMACRO_OLED_DISPLAY
config LVGL_HOR_RES_MAX
	default 128

config LVGL_VER_RES_MAX
	default 32

config LVGL_VDB_SIZE
	default 64

config LVGL_DPI
	default 148
endif # NRFMACRO_OLED_DISPLAY

## epd display configuration
if NRFMACRO_EPD_DISPLAY
config NRFMACRO_EPD_ROTATE_180
  bool "rotate the epd upside-down"

config LVGL_HOR_RES_MAX
	default 80

config LVGL_VER_RES_MAX
	default 128

config LVGL_VDB_SIZE
	default 100

config LVGL_DPI
	default 145
endif # NRFMACRO_EPD_DISPLAY

## memory lcd display configuration
if NRFMACRO_LCD_DISPLAY
choice LVGL_THEME_DEFAULT_FONT_SMALL
    default LVGL_THEME_DEFAULT_FONT_SMALL_MONTSERRAT_36
endchoice

config LVGL_HOR_RES_MAX
	default 160

config LVGL_VER_RES_MAX
	default 68

config LVGL_VDB_SIZE
	default 16

config LVGL_DPI
	default 30
endif # NRFMACRO_LCD_DISPLAY

endif # LVGL

# custom widgets configuration
menuconfig CUSTOM_WIDGET_BATTERY_STATUS
	bool "custom battery status widget"

menuconfig CUSTOM_WIDGET_OUTPUT_STATUS
	bool "custom output status widget"

menuconfig CUSTOM_WIDGET_LAYER_STATUS
	bool "custom layer status widget"

menuconfig CUSTOM_WIDGET_PERIPHERAL_STATUS
	bool "custom layer status widget"

# add point device
config NRFMACRO_POINTDEVICE
  bool "add support for point device"
  select SPI

endif # BOARD_NRFMACRO
```

## app/boards/moergo/go60/Kconfig.board
```kconfig
# Copyright (c) 2021 The ZMK Contributors
# SPDX-License-Identifier: MIT

config BOARD_GO60_LH
    bool "Go60 LH"
    depends on SOC_NRF52840_QIAA

config BOARD_GO60_RH
    bool "Go60 RH"
    depends on SOC_NRF52840_QIAA
```

## app/boards/moergo/go60/board.yml
```yaml
boards:
  - name: go60_rh
    vendor: moergo
    socs:
      - name: nrf52840
  - name: go60_lh
    vendor: moergo
    socs:
      - name: nrf52840
```

## app/boards/shields/blade/Kconfig.defconfig
```kconfig
# Copyright (c) 2020 The ZMK Contributors
# SPDX-License-Identifier: MIT

if BLADE_RIGHT

config ZMK_KEYBOARD_NAME
	default "Blade"

config ZMK_SPLIT_BLE_ROLE_CENTRAL
	default y

endif

if BLADE_LEFT
config ZMK_KEYBOARD_NAME
  default "Blade-slave"

endif

if BLADE_LEFT || BLADE_RIGHT

config ZMK_SPLIT
	default y

config ZMK_USB
	default y

config NRFMACRO_MARKLOGO_NAME
  string  "Source file name of the shield mark logo"
  default "sweepro-marklogo.c"
endif
```

## app/boards/shields/blade/Kconfig.shield
```kconfig
# Copyright (c) 2020 The ZMK Contributors
# SPDX-License-Identifier: MIT

config BLADE_LEFT
	def_bool $(shields_list_contains,blade_left)

config BLADE_RIGHT
	def_bool $(shields_list_contains,blade_right)
```

## app/boards/shields/corne-pro/Kconfig.defconfig
```kconfig
# Copyright (c) 2020 The ZMK Contributors
# SPDX-License-Identifier: MIT

if CORNE_PRO_LEFT

config ZMK_KEYBOARD_NAME
	default "Corne-Pro"

config ZMK_SPLIT_BLE_ROLE_CENTRAL
	default y

endif

if CORNE_PRO_RIGHT
config ZMK_KEYBOARD_NAME
  default "Corne-Pro-R"

endif

if CORNE_PRO_LEFT || CORNE_PRO_RIGHT

config ZMK_SPLIT
	default y

config ZMK_USB
	default y

config NRFMACRO_MARKLOGO_NAME
  string  "Source file name of the shield mark logo"
  default "cornepro-marklogo.c"

endif
```

## app/boards/shields/corne-pro/Kconfig.shield
```kconfig
# Copyright (c) 2020 The ZMK Contributors
# SPDX-License-Identifier: MIT

config CORNE_PRO_LEFT
	def_bool $(shields_list_contains,corne-pro_left)

config CORNE_PRO_RIGHT
	def_bool $(shields_list_contains,corne-pro_right)
```

## app/boards/shields/corne_cirque/Kconfig.shield
```kconfig
# Copyright (c) 2020 Pete Johanson
# SPDX-License-Identifier: MIT

config SHIELD_CORNE_CIRQUE_LEFT
	def_bool $(shields_list_contains,corne_cirque_left)

config SHIELD_CORNE_CIRQUE_RIGHT
	def_bool $(shields_list_contains,corne_cirque_right)
```

## app/boards/shields/sweep-pro/Kconfig.defconfig
```kconfig
# Copyright (c) 2020 The ZMK Contributors
# SPDX-License-Identifier: MIT

if SWEEP_PRO_LEFT

config ZMK_KEYBOARD_NAME
	default "Sweep-Pro"

config ZMK_SPLIT_BLE_ROLE_CENTRAL
	default y

endif

if SWEEP_PRO_RIGHT
config ZMK_KEYBOARD_NAME
  default "Sweep-Pro-R"

endif

if SWEEP_PRO_LEFT || SWEEP_PRO_RIGHT

config ZMK_SPLIT
	default y

config ZMK_USB
	default y

config NRFMACRO_MARKLOGO_NAME
  string  "Source file name of the shield mark logo"
  default "sweepro-marklogo.c"
endif
```

## app/boards/shields/sweep-pro/Kconfig.shield
```kconfig
# Copyright (c) 2020 The ZMK Contributors
# SPDX-License-Identifier: MIT

config SWEEP_PRO_LEFT
	def_bool $(shields_list_contains,sweep-pro_left)

config SWEEP_PRO_RIGHT
	def_bool $(shields_list_contains,sweep-pro_right)
```

## app/boards/shields/sweepro-ce/Kconfig.defconfig
```kconfig
# Copyright (c) 2020 The ZMK Contributors
# SPDX-License-Identifier: MIT

if SWEEPRO_CE_LEFT

config ZMK_KEYBOARD_NAME
	default "SweepPro-CE"

config ZMK_SPLIT_BLE_ROLE_CENTRAL
	default y

endif

if SWEEPRO_CE_RIGHT
config ZMK_KEYBOARD_NAME
  default "SweepPro-CE-R"

endif

if SWEEPRO_CE_LEFT || SWEEPRO_CE_RIGHT

config ZMK_SPLIT
	default y

config ZMK_USB
	default y

config NRFMACRO_MARKLOGO_NAME
  string  "Source file name of the shield mark logo"
  default "sweepro-marklogo.c"
endif
```

## app/boards/shields/sweepro-ce/Kconfig.shield
```kconfig
# Copyright (c) 2020 The ZMK Contributors
# SPDX-License-Identifier: MIT

config SWEEPRO_CE_LEFT
	def_bool $(shields_list_contains,sweepro-ce_left)

config SWEEPRO_CE_RIGHT
	def_bool $(shields_list_contains,sweepro-ce_right)
```

## app/boards/shields/tracktyl/Kconfig.defconfig
```kconfig
if SHIELD_TRACKTYL_RIGHT

    config ZMK_KEYBOARD_NAME
        default "Tracktyl"

    config ZMK_SPLIT_BLE_ROLE_CENTRAL
        default y

endif

if SHIELD_TRACKTYL_LEFT

    config ZMK_KEYBOARD_NAME
        default "Tracktyl_left"
endif

if SHIELD_TRACKTYL_LEFT || SHIELD_TRACKTYL_RIGHT

    config ZMK_SPLIT
        default y

    config ZMK_USB
        default y

endif
```

## app/boards/shields/tracktyl/Kconfig.shield
```kconfig
config SHIELD_TRACKTYL_LEFT
    def_bool $(shields_list_contains,tracktyl_left)

config SHIELD_TRACKTYL_RIGHT
    def_bool $(shields_list_contains,tracktyl_right)
```
