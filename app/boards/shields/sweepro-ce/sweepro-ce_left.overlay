/*
 * Copyright (c) 2020 The ZMK Contributors
 *
 * SPDX-License-Identifier: MIT
 */

#include "sweepro-ce.dtsi"

// setup display
// &chosen {
//   zephyr,display = &epd;
// };

// &nrfmacro_spi {
//   status = "okay";
// };

// setup kscan pins
&kscan_matrix {
	col-gpios
		= <&pro_micro 21 GPIO_ACTIVE_HIGH>
		, <&pro_micro 20 GPIO_ACTIVE_HIGH>
		, <&pro_micro 19 GPIO_ACTIVE_HIGH>
		, <&pro_micro 18 GPIO_ACTIVE_HIGH>
		, <&pro_micro 15 GPIO_ACTIVE_HIGH>
		;
};

&encoder_keys {
			column-offset = <2>;
};

// enable left encoder
&left_encoder {
	status = "okay";
};