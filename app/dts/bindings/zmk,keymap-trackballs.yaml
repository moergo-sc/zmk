## app/dts/bindings/zmk,keymap-trackballs.yaml
```yaml
# Copyright (c) 2020 The ZMK Contributors
# SPDX-License-Identifier: MIT

description: |
  Collection of trackballs bound in the keymap layers, the layer key is used to switch working mode.

compatible: "zmk,keymap-trackballs"

properties:
  trackballs:
    type: phandles
    required: true
```

## app/dts/bindings/zmk,underglow-indicators.yaml
```yaml
# Copyright (c) 2020, The ZMK Contributors
# SPDX-License-Identifier: MIT

description: Underglow indicators

compatible: "zmk,underglow-indicators"

properties:
  bat-self:
    type: array
    default: []
  bat-other:
    type: array
    default: []
  capslock:
    type: int
    default: -1
  numlock:
    type: int
    default: -1
  scrolllock:
    type: int
    default: -1
  layer-state:
    type: array
    default: []
  ble-state:
    type: array
    default: []
  usb-state:
    type: int
    default: -1
  output-fallback:
    type: int
    default: -1
```

## app/dts/bindings/zmk,underglow-layer.yaml
```yaml
description: |
  Allows defining a rgbmap composed of multiple layers

compatible: "zmk,underglow-layer"

child-binding:
  description: "A layer to be used in a rgbmap"

  properties:
    bindings:
      type: array
      required: true
    layer-id:
      type: int
      required: true
```

## app/dts/bindings/zmk,underglow-transform.yaml
```yaml
description: |
  Defines a mapping from rgb underglow logical positions to matrix physical positions

compatible: "zmk,underglow-transform"

properties:
  columns:
    type: int
    required: true
  rows:
    type: int
    required: true
  map:
    type: array
    required: true
```

## app/module/dts/bindings/kscan/zmk,kscan-cap1203.yaml
```yaml
# Copyright (c) 2022 Yong Zhou
# SPDX-License-Identifier: MIT

description: CAP1203 3-channel capacitive touch sensor

compatible: "zmk,kscan-cap1203"

include: [kscan.yaml, i2c-device.yaml]

properties:
    invert-direction:
      type: boolean
    int-gpios:
      type: phandle-array
      required: false
```

## app/module/dts/bindings/sensor/pixart,paw3395.yaml
```yaml
# Copyright (c) 2022 The ZMK Contributors
# SPDX-License-Identifier: MIT
description: |
  Sensor driver for the pixart PAW3395 optical mouse sensor 

compatible: "pixart,paw3395"

include: spi-device.yaml

properties:
  label:
    type: string
    required: true
  irq-gpios:
    type: phandle-array
    required: true
  scroll-layer:
    type: int
    description: the momentary layer used to modifiy move to scroll
    required: false
```

## app/module/dts/bindings/sensor/zmk,battery-max17048.yaml
```yaml
# Copyright (c) 2022 Yong Zhou
# SPDX-License-Identifier: MIT

description: Maxim MAX17048 Fuel Gauge

compatible: "zmk,battery-max17048"

include: [i2c-device.yaml]
```

## app/src/point_device/Kconfig
```kconfig
# Copyright (c) 2021 The ZMK Contributors
# SPDX-License-Identifier: MIT

DT_COMPAT_ZMK_KEYMAP_TRACKBALLS := zmk,keymap-trackballs
DT_COMPAT_ZMK_KEYMAP_SLIDERS := zmk,keymap-sliders

menuconfig ZMK_POINT_DEVICE
    bool "Enable support for ZMK general point device"
    default n

if ZMK_POINT_DEVICE

choice ZMK_PD_WORK_QUEUE
    prompt "Work queue used to process point device events"

config ZMK_PD_WORK_QUEUE_DEDICATED
    bool "Use dedicated work queue for point device events"

config ZMK_PD_WORK_QUEUE_SYSTEM
    bool "Use default system work queue for point device events"
endchoice

if ZMK_PD_WORK_QUEUE_DEDICATED

config ZMK_PD_DEDICATED_WORK_QUEUE_STACK_SIZE
    int "Stack size for dedicated point device thread/queue"
    default 2048

config ZMK_PD_DEDICATED_WORK_QUEUE_PRIORITY
    int "Thread priority for dedicated point device thread/queue"
    default 2

endif # ZMK_PD_WORK_QUEUE_DEDICATED

choice ZMK_PD_SEND_THREAD
    prompt "Thread used to send mouse report"

config ZMK_PD_SEND_THREAD_DEDICATED
    bool "Use dedicated thread to send mouse report"

config ZMK_PD_SEND_THREAD_SHARED
    bool "Use default zmk work queue to send mouse report"
endchoice

if ZMK_PD_SEND_THREAD_DEDICATED

config ZMK_PD_DEDICATED_SEND_THREAD_STACK_SIZE
    int "Stack size for dedicated point device sending thread"
    default 2048

config ZMK_PD_DEDICATED_SEND_THREAD_PRIORITY
    int "Thread priority for dedicated point device sending thread"
    default -1

endif # ZMK_PD_SEND_THREAD_DEDICATED

config ZMK_BHV_PD_DIR_TIME_WINDOW
    int "Time window (ms) of directional behavior of point device"
    default 300

endif # ZMK_POINT_DEVICE

config ZMK_SLIDERS
	bool
	default $(dt_compat_enabled,$(DT_COMPAT_ZMK_KEYMAP_SLIDERS))
  select ZMK_POINT_DEVICE

config ZMK_TRACKBALLS
	bool
	default $(dt_compat_enabled,$(DT_COMPAT_ZMK_KEYMAP_TRACKBALLS))
  select ZMK_POINT_DEVICE

if ZMK_TRACKBALLS
config ZMK_TRACKBALL_USB_POLL_INTERVAL
    int "Poll interval in ms under wired connection"
    default 8

config ZMK_TRACKBALL_BLE_POLL_INTERVAL
    int "Poll interval in ms under bluetooth connection"
    default 8

config ZMK_TRACKBALL_POLL_DURATION
    int "Duration of polling after receiving an interrupt in ms"
    default 300

endif # ZMK_TRACKBALLS
```
